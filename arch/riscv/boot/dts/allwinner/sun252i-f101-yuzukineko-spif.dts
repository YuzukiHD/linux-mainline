// SPDX-License-Identifier: GPL-2.0-only OR MIT
/dts-v1/;

/*
 * The NOR flash on the SPI flash controller instead of SPI0: same pads
 * PC0..PC5.
 */
#include "sun252i-f101-yuzukineko-common.dtsi"

&spi0 {
	status = "disabled";
};

&spif {
	pinctrl-names = "default";
	pinctrl-0 = <&spif0_pc_pins>;
	/* The start of the rootfs: data to tune the sample point on */
	allwinner,tune-offset = <0x6d1000>;
	status = "okay";

	flash@0 {
		compatible = "jedec,spi-nor";
		reg = <0>;
		spi-max-frequency = <100000000>;
		spi-rx-bus-width = <4>;
		spi-tx-bus-width = <4>;

		#include "sun252i-f101-nor-partitions.dtsi"
	};
};
