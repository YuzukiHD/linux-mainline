## Documentation/devicetree/bindings/arm/sunxi/allwinner,sun252i-f101-mbus.yaml
```yaml
# SPDX-License-Identifier: GPL-2.0-only OR BSD-2-Clause
%YAML 1.2
---
$id: http://devicetree.org/schemas/arm/sunxi/allwinner,sun252i-f101-mbus.yaml#
$schema: http://devicetree.org/meta-schemas/core.yaml#

title: Allwinner F101 memory bus (MBUS) arbitration

maintainers:
  - Yuzuki Tsuru <gloomyghost@gloomyghost.com>

description:
  The memory bus of the F101 has registers that set the priority of each bus
  master and limit its bandwidth, and a monitor that counts the traffic of
  the groups of masters. A child node sets the arbitration of one master.

properties:
  compatible:
    const: allwinner,sun252i-f101-mbus

  reg:
    maxItems: 1

  clocks:
    maxItems: 2

  clock-names:
    items:
      - const: bus
      - const: mbus

  resets:
    maxItems: 1

  allwinner,monitor-window-us:
    description: Length of the window the traffic monitor counts bytes in.
    default: 50000
    maximum: 65535

  "#address-cells":
    const: 1

  "#size-cells":
    const: 0

patternProperties:
  "^[a-z0-9-]+@[0-9a-f]+$":
    type: object
    additionalProperties: false
    description: A bus master.

    properties:
      reg:
        maxItems: 1
        description: The number of the master, see the header.

      priority:
        $ref: /schemas/types.yaml#/definitions/uint32
        minimum: 0
        maximum: 3
        description: Arbitration priority, 3 is the highest.

      bandwidth-limit-mbps:
        $ref: /schemas/types.yaml#/definitions/uint32
        description: Bandwidth limit of the master in MB/s, 0 is no limit.

    required:
      - reg

required:
  - compatible
  - reg
  - clocks
  - clock-names

additionalProperties: false

examples:
  - |
    #include <dt-bindings/clock/sun252i-f101-ccu.h>
    #include <dt-bindings/memory/sun252i-f101-mbus.h>

    mbus@3102000 {
        compatible = "allwinner,sun252i-f101-mbus";
        reg = <0x03102000 0x1000>;
        clocks = <&ccu CLK_MBUS>;
        clock-names = "mbus";
        #address-cells = <1>;
        #size-cells = <0>;

        display-engine@10 {
            reg = <SUN252I_F101_MBUS_MASTER_DE>;
            priority = <3>;
        };

        cpu@27 {
            reg = <SUN252I_F101_MBUS_MASTER_RISCV>;
            bandwidth-limit-mbps = <500>;
        };
    };
```

## Documentation/devicetree/bindings/display/panel/jadard,jd9168s.yaml
```yaml
# SPDX-License-Identifier: GPL-2.0-only OR BSD-2-Clause
%YAML 1.2
---
$id: http://devicetree.org/schemas/display/panel/jadard,jd9168s.yaml#
$schema: http://devicetree.org/meta-schemas/core.yaml#

title: Jadard JD9168S based MIPI DSI panel

maintainers:
  - Yuzuki Tsuru <gloomyghost@gloomyghost.com>

description:
  A 1024x768 MIPI DSI panel with a Jadard JD9168S controller, on four lanes.

allOf:
  - $ref: panel-common.yaml#

properties:
  compatible:
    const: jadard,jd9168s

  reg:
    maxItems: 1

  reset-gpios: true
  backlight: true

required:
  - compatible
  - reg
  - reset-gpios

additionalProperties: false

examples:
  - |
    #include <dt-bindings/gpio/gpio.h>

    dsi {
        #address-cells = <1>;
        #size-cells = <0>;

        panel@0 {
            compatible = "jadard,jd9168s";
            reg = <0>;
            reset-gpios = <&pio 3 9 GPIO_ACTIVE_LOW>;
            backlight = <&backlight>;
        };
    };
...
```

## Documentation/devicetree/bindings/media/allwinner,sun252i-f101-g2d.yaml
```yaml
# SPDX-License-Identifier: (GPL-2.0-only OR BSD-2-Clause)
%YAML 1.2
---
$id: http://devicetree.org/schemas/media/allwinner,sun252i-f101-g2d.yaml#
$schema: http://devicetree.org/meta-schemas/core.yaml#

title: Allwinner F101 G2D

maintainers:
  - Yuzuki Tsuru <gloomyghost@gloomyghost.com>

description:
  The 2D graphics engine of the F101 converts, scales, rotates and flips
  pictures in memory.

properties:
  compatible:
    const: allwinner,sun252i-f101-g2d

  reg:
    maxItems: 1

  interrupts:
    maxItems: 1

  clocks:
    items:
      - description: Module clock
      - description: Bus gate
      - description: Memory bus gate

  clock-names:
    items:
      - const: mod
      - const: bus
      - const: mbus

  resets:
    maxItems: 1

required:
  - compatible
  - reg
  - interrupts
  - clocks
  - clock-names
  - resets

additionalProperties: false

examples:
  - |
    #include <dt-bindings/clock/sun252i-f101-ccu.h>
    #include <dt-bindings/interrupt-controller/irq.h>
    #include <dt-bindings/reset/sun252i-f101-ccu.h>

    g2d@5410000 {
        compatible = "allwinner,sun252i-f101-g2d";
        reg = <0x05410000 0x40000>;
        interrupts = <111 IRQ_TYPE_LEVEL_HIGH>;
        clocks = <&ccu CLK_G2D>, <&ccu CLK_BUS_G2D>, <&ccu CLK_BUS_G2D_M>;
        clock-names = "mod", "bus", "mbus";
        resets = <&ccu RST_BUS_G2D>;
    };
```

## Documentation/devicetree/bindings/spi/allwinner,sun252i-f101-spif.yaml
```yaml
# SPDX-License-Identifier: GPL-2.0
%YAML 1.2
---
$id: http://devicetree.org/schemas/spi/allwinner,sun252i-f101-spif.yaml#
$schema: http://devicetree.org/meta-schemas/core.yaml#

title: Allwinner F101 SPI Flash Controller

description:
  A controller dedicated to SPI flashes. It shares the pads of the SPI0
  controller. A flash command, with its address, dummy and data phases, is
  one descriptor fetched by the controller's own DMA.

allOf:
  - $ref: spi-controller.yaml

maintainers:
  - Yuzuki Tsuru <gloomyghost@gloomyghost.com>

properties:
  compatible:
    const: allwinner,sun252i-f101-spif

  reg:
    maxItems: 1

  clocks:
    items:
      - description: Bus Clock
      - description: Module Clock

  clock-names:
    items:
      - const: ahb
      - const: mod

  resets:
    maxItems: 1

  allwinner,tune-offset:
    $ref: /schemas/types.yaml#/definitions/uint32
    description:
      Offset in the flash of a 4 KiB place that reads the same on every try
      and is not blank. Over 50 MHz the controller samples the data at a
      point that depends on the board; with this property it is found the
      first time a bulk read runs at that speed, by comparing the reads at
      each point with the same read at 24 MHz. Without it the controller
      does not go over 50 MHz.

required:
  - compatible
  - reg
  - clocks
  - clock-names
  - resets

unevaluatedProperties: false

examples:
  - |
    spi@c000000 {
        compatible = "allwinner,sun252i-f101-spif";
        reg = <0x0c000000 0x1000>;
        clocks = <&ccu 57>, <&ccu 56>;
        clock-names = "ahb", "mod";
        resets = <&ccu 28>;
        allwinner,tune-offset = <0x6d1000>;
        #address-cells = <1>;
        #size-cells = <0>;

        flash@0 {
            compatible = "jedec,spi-nor";
            reg = <0>;
            spi-max-frequency = <100000000>;
            spi-rx-bus-width = <4>;
        };
    };
```

## arch/riscv/configs/sun252i_f101_rv64_yuzukineko_defconfig
```kconfig
CONFIG_EXPERT=y
# CONFIG_KALLSYMS is not set
CONFIG_ARCH_SUNXI=y
CONFIG_NONPORTABLE=y
CONFIG_CMODEL_MEDLOW=y
CONFIG_THREAD_SIZE_ORDER=1
CONFIG_RISCV_SBI_V01=y
CONFIG_CMDLINE="console=ttyS1,115200n8 earlycon loglevel=8 printk.time=1"
# CONFIG_EFI is not set
# CONFIG_STRICT_KERNEL_RWX is not set
CONFIG_MODULES=y
CONFIG_DEVTMPFS=y
CONFIG_DEVTMPFS_MOUNT=y
CONFIG_MTD=y
CONFIG_MTD_BLOCK=y
CONFIG_MTD_SPI_NOR=y
# CONFIG_LEGACY_PTYS is not set
CONFIG_SERIAL_8250=y
CONFIG_SERIAL_8250_CONSOLE=y
CONFIG_SERIAL_8250_DW=y
CONFIG_I2C_CHARDEV=y
CONFIG_I2C_MV64XXX=y
CONFIG_SPI=y
CONFIG_SPI_SUN6I=y
CONFIG_REGULATOR=y
CONFIG_REGULATOR_FIXED_VOLTAGE=y
CONFIG_MEDIA_SUPPORT=y
CONFIG_MEDIA_SUPPORT_FILTER=y
CONFIG_MEDIA_PLATFORM_SUPPORT=y
CONFIG_MMC=y
CONFIG_MMC_SUNXI=y
CONFIG_DMADEVICES=y
CONFIG_DMA_SUN6I=y
CONFIG_STAGING=y
CONFIG_STAGING_MEDIA=y
CONFIG_VIDEO_SUNXI=y
CONFIG_VIDEO_SUNXI_CEDRUS=y
CONFIG_PWM=y
CONFIG_PWM_SUNXI=y
CONFIG_OVERLAY_FS=y
CONFIG_TMPFS=y
CONFIG_JFFS2_FS=y
CONFIG_JFFS2_FS_XATTR=y
CONFIG_SQUASHFS=y
CONFIG_SQUASHFS_XZ=y
CONFIG_PRINTK_TIME=y
CONFIG_DYNAMIC_DEBUG=y
# CONFIG_DEBUG_BUGVERBOSE is not set
CONFIG_FRAME_WARN=1280
CONFIG_DEBUG_FS=y
# CONFIG_SLUB_DEBUG is not set
```

## arch/riscv/configs/sun252i_f101_yuzukineko_defconfig
```kconfig
CONFIG_EXPERT=y
CONFIG_ARCH_SUNXI=y
CONFIG_NONPORTABLE=y
CONFIG_ARCH_RV32I=y
CONFIG_RISCV_SBI_V01=y
CONFIG_CMDLINE="console=ttyS1,115200n8 earlycon loglevel=8 printk.time=1"
# CONFIG_EFI is not set
# CONFIG_STRICT_KERNEL_RWX is not set
CONFIG_MODULES=y
CONFIG_DEVTMPFS=y
CONFIG_DEVTMPFS_MOUNT=y
CONFIG_TMPFS=y
CONFIG_MEDIA_SUPPORT=y
CONFIG_MEDIA_SUPPORT_FILTER=y
CONFIG_MEDIA_PLATFORM_SUPPORT=y
CONFIG_STAGING=y
CONFIG_STAGING_MEDIA=y
CONFIG_VIDEO_SUNXI=y
CONFIG_VIDEO_SUNXI_CEDRUS=y
CONFIG_BLOCK=y
CONFIG_MMC=y
CONFIG_MMC_BLOCK=y
CONFIG_MMC_SUNXI=y
CONFIG_REGULATOR=y
CONFIG_REGULATOR_FIXED_VOLTAGE=y
CONFIG_MTD=y
CONFIG_MTD_BLOCK=y
CONFIG_MTD_OF_PARTS=y
CONFIG_MTD_SPI_NOR=y
CONFIG_SQUASHFS=y
CONFIG_SQUASHFS_XZ=y
CONFIG_VFAT_FS=y
CONFIG_FAT_DEFAULT_IOCHARSET="iso8859-1"
CONFIG_NLS_CODEPAGE_437=y
CONFIG_NLS_ISO8859_1=y
CONFIG_OVERLAY_FS=y
CONFIG_JFFS2_FS=y
CONFIG_JFFS2_FS_XATTR=y
CONFIG_SERIAL_8250=y
CONFIG_SERIAL_8250_CONSOLE=y
CONFIG_SERIAL_8250_DW=y
CONFIG_I2C=y
CONFIG_I2C_CHARDEV=y
CONFIG_I2C_MV64XXX=y
CONFIG_SPI=y
CONFIG_SPI_SUN6I=y
CONFIG_SPI_SUNXI_SPIF=y
CONFIG_DMADEVICES=y
CONFIG_DMA_SUN6I=y
CONFIG_PWM=y
CONFIG_PWM_SUNXI=y
CONFIG_PRINTK_TIME=y
CONFIG_DYNAMIC_DEBUG=y
# CONFIG_DEBUG_BUGVERBOSE is not set
CONFIG_DEBUG_FS=y
# CONFIG_SLUB_DEBUG is not set
# CONFIG_KALLSYMS is not set
# CONFIG_LEGACY_PTYS is not set
CONFIG_SUNXI_SRAM=y
CONFIG_BACKLIGHT_CLASS_DEVICE=y
CONFIG_BACKLIGHT_PWM=y
CONFIG_DRM=y
CONFIG_DRM_FBDEV_EMULATION=y
CONFIG_DRM_PANEL_JADARD_JD9168S=y
CONFIG_DRM_SUN4I=y
CONFIG_DRM_SUN6I_DSI=y
CONFIG_PHY_SUN6I_MIPI_DPHY=y
CONFIG_FRAMEBUFFER_CONSOLE=y
CONFIG_LOGO=y
CONFIG_SUN252I_F101_MBUS=y
CONFIG_V4L_MEM2MEM_DRIVERS=y
CONFIG_VIDEO_SUN252I_G2D=y
CONFIG_VIDEO_DEV=y
```

## drivers/media/platform/sunxi/sun252i-g2d/Kconfig
```kconfig
# SPDX-License-Identifier: GPL-2.0-only

config VIDEO_SUN252I_G2D
	tristate "Allwinner F101 G2D scaler and rotation driver"
	depends on V4L_MEM2MEM_DRIVERS
	depends on VIDEO_DEV
	depends on ARCH_SUNXI || COMPILE_TEST
	depends on COMMON_CLK && RESET_CONTROLLER && OF
	select VIDEOBUF2_DMA_CONTIG
	select V4L2_MEM2MEM_DEV
	help
	   Support for the 2D graphics engine of the Allwinner F101 as a
	   memory to memory device: it converts YUV and RGB pictures to
	   RGB, scales them and rotates or flips them.
	   To compile this driver as a module choose m here.
```

## drivers/soc/sunxi/Kconfig
```kconfig
# SPDX-License-Identifier: GPL-2.0-only
#
# Allwinner sunXi SoC drivers
#

config SUNXI_MBUS
	bool
	default ARCH_SUNXI
	depends on ARM || ARM64
	help
	  Say y to enable the fixups needed to support the Allwinner
	  MBUS DMA quirks.

config SUNXI_SRAM
	bool
	default ARCH_SUNXI
	select REGMAP_MMIO
	help
	  Say y here to enable the SRAM controller support. This
	  device is responsible on mapping the SRAM in the sunXi SoCs
	  whether to the CPU/DMA, or to the devices.

config SUN252I_F101_MBUS
	tristate "Allwinner F101 memory bus arbitration"
	depends on ARCH_SUNXI || COMPILE_TEST
	help
	  Say y here to set the priority and the bandwidth limit of the bus
	  masters of the memory bus of the Allwinner F101 from the devicetree,
	  and to have its traffic counters in debugfs.
```
